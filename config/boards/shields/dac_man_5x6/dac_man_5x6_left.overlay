#include "dac_man_5x6.dtsi"

/ {
    button0: button_0 {
        compatible = "gpio-keys";

        button_reset: button-reset {
            label = "Top button";
            gpios = <&gpio0 29 (GPIO_ACTIVE_LOW | GPIO_PULL_UP)>;
            zephyr,code = <RESET>;
        };
    };
};

&kscan0 {
    col-gpios
        = <&gpio1 6  GPIO_ACTIVE_HIGH>
        , <&gpio1 4  GPIO_ACTIVE_HIGH>
        , <&gpio0 11 GPIO_ACTIVE_HIGH>
        , <&gpio1 0  GPIO_ACTIVE_HIGH>
        , <&gpio0 24 GPIO_ACTIVE_HIGH>
        , <&gpio0 22 GPIO_ACTIVE_HIGH>
        ;
};

//&kscan0 {
//    col-gpios
//        = <&pro_micro_d 4 GPIO_ACTIVE_HIGH>
//	, <&pro_micro_d 5 GPIO_ACTIVE_HIGH>
//        , <&pro_micro_d 6 GPIO_ACTIVE_HIGH>
//        , <&pro_micro_d 7 GPIO_ACTIVE_HIGH>
//        , <&pro_micro_d 8 GPIO_ACTIVE_HIGH>
//        , <&pro_micro_d 9 GPIO_ACTIVE_HIGH>
//        ;
//};
